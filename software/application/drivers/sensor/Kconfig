## software/application/drivers/sensor/pms5003/Kconfig
```kconfig
config PMS5003
    bool "PMS5003 particulate matter sensor"
    default y
    depends on SERIAL
    depends on DT_HAS_PLANTOWER_PMS5003_ENABLED
    help
        Enable driver for PMS5003 particulate matter sensor.
```

## software/application/dts/bindings/sensor/plantower,pms5003.yaml
```yaml
description: |
  PMS5003 is a particulate matter sensor.

compatible: "plantower,pms5003"

include: [base.yaml, uart-device.yaml]
```

## software/application/west.yml
```yaml
manifest:

  self:
    path: app

  remotes:
    - name: zephyrproject-rtos
      url-base: https://github.com/zephyrproject-rtos

  projects:
    - name: zephyr
      remote: zephyrproject-rtos
      revision: main
      import:
        name-allowlist:
          - cmsis
          - hal_espressif
          - mbedtls
          - tf-psa-crypto
```
